## main/Kconfig.projbuild
```kconfig
menu "BNO055-test Configuration"

    config I2C_MASTER_NUM
        int "I2C Master Num"
        default 0
        help
            I2C master line.

    config I2C_FREQUENCY
        int "I2C Frequency"
        default 100000
        help
            I2C frequency. 100k or 400k but only 100k seems to be working.

    config I2C_MASTER_SCL
        int "SCL GPIO Num"
        default 16
        help
            GPIO number for I2C Master clock line.

    config I2C_MASTER_SDA
        int "SDA GPIO Num"
        default 15
        help
            GPIO number for I2C Master data line.

    config BLINK_GPIO
        int "Blink GPIO number"
        range 0 48
        default 38
        help
            GPIO number of the LED (38 in v0.1)

endmenu
```
